## external_packages/package/first-package/Config.in
```kconfig
config BR2_PACKAGE_FIRST_PACKAGE
	bool "first-package"
	help
	  This is an external package for buildroot
```

## external_packages/package/socket-package/Config.in
```kconfig
config BR2_PACKAGE_SOCKET_PACKAGE
	bool "socket-package"
	help
	  This is an external package for buildroot
```
